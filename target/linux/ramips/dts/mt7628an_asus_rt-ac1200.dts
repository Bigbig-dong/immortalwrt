// SPDX-License-Identifier: GPL-2.0-or-later OR MIT
// Copyright (c) 2022 Ray Wang
// Copyright (c) 2022 Ivan Pavlov

#include <dt-bindings/leds/common.h>

#include "mt7628an_asus_rt-ac1200.dtsi"

/ {
	compatible = "asus,rt-ac1200", "mediatek,mt7628an-soc";
	model = "Asus RT-AC1200";
};

&state_default {
	gpio {
		groups = "i2c", "spi cs1", "refclk", "wled_an";
		function = "gpio";
	};
};
